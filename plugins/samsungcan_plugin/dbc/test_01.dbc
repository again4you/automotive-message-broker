VERSION "HIPBNYYYYYYYYYYYYYYYYYYYYYYYYYYYYYYYYYYYYY/4/%%%/4/'%**4YYY///"

NS_ :

BS_:

BU_:

BO_ 257 CAN01: 8 Vector__XXX
 SG_ DriveMode : 16|8@1+ (1,0) [0|255] "" Vector__XXX

CM_ SG_ 257 DriveMode "Drive Mode";
BA_DEF_  "BusType" STRING ;
BA_DEF_DEF_  "BusType" "CAN";
VAL_ 257 DriveMode 10 "Normal" 12 "ECO" 13 "SPORT" ;
